#include <Wire.h>
#include <Adafruit_GFX.h>
#include <Adafruit_SSD1306.h>

#define SCREEN_WIDTH 128
#define SCREEN_HEIGHT 64
#define OLED_RESET    -1
Adafruit_SSD1306 display(SCREEN_WIDTH, SCREEN_HEIGHT, &Wire, OLED_RESET);

const int BYTES_PER_LINE = 1024; // 128 * 64 / 8 bytes

// Total 13 rows: Row 0 is the image, Rows 1-8 are the 8 lyric lines
const unsigned char bitmapArray[8][1024] PROGMEM = {
  {0x00, 0x00, 0x00, 0x00, 0x00, 0x00, 0x00, 0x00, 0x00, 0x00, 0x00, 0x00, 0x00, 0x00, 0x00, 0x00, 
	0x00, 0x00, 0x00, 0x00, 0x00, 0x00, 0x00, 0x00, 0x00, 0x00, 0x00, 0x00, 0x00, 0x00, 0x00, 0x00, 
	0x00, 0x00, 0x00, 0x00, 0x00, 0x00, 0x00, 0x00, 0x00, 0x00, 0x00, 0x00, 0x00, 0x00, 0x00, 0x00, 
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	0x00, 0x00, 0x00, 0x00, 0x00, 0x00, 0x00, 0x00, 0x00, 0x00, 0x00, 0x00, 0x00, 0x00, 0x00, 0x00}
};

void setup() {
  Serial.begin(115200);

  if(!display.begin(SSD1306_SWITCHCAPVCC, 0x3C)) {
    Serial.println(F("SSD1306 allocation failed"));
    for(;;);
  }

  display.clearDisplay();
  display.display();
}

void loop() {
  // Loop through all 13 items (0 to 12)
  for (int i = 0; i < 9; i++) {
    display.clearDisplay();
    
    // Draw the current bitmap (Image is at i=0, lines are at i=1 to 12)
    display.drawBitmap(0, 0, bitmapArray[i], 128, 64, SSD1306_WHITE);
    
    display.display();
    
    // You can give a longer delay for the title image if you want (e.g., 4 seconds)
    if (i == 0) 
    {
      delay(8000); 
    }
    if (i == 1) 
    {
      delay(5000); 
    }
    if (i == 2) 
    {
      delay(6000); 
    }
    if (i == 3) 
    {
      delay(4000); 
    }
    if (i == 4) 
    {
      delay(3000); 
    }
    if (i == 5) 
    {
      delay(3000); 
    }
    if (i == 6) 
    {
      delay(3000); 
    }
    if (i == 7) 
    {
      delay(3000); 
    }
    else 
    {
      delay(3000); // 3 seconds for each lyric line
    }
  }
}